## conf/distro/include/oel-providers.conf
```bitbake
# Prefer normal jpeg implementation
PREFERRED_PROVIDER_jpeg               ??= "jpeg"
PREFERRED_PROVIDER_jpeg-native        ??= "jpeg-native"
PREFERRED_PROVIDER_libevent           ??= "libevent"
PREFERRED_PROVIDER_ltp        	      ??= "ltp"
PREFERRED_PROVIDER_eglibc             ??= "eglibc"
PREFERRED_PROVIDER_virtual/x86_64-oelsdk-linux-binutils-crosssdk ??= "binutils-crosssdk"
PREFERRED_PROVIDER_virtual/i686-oelsdk-linux-binutils-crosssdk ??= "binutils-crosssdk"

# Dont build xen due to poor target support upstream
PACKAGECONFIG_pn-libvirt = "qemu yajl uml openvz vmware vbox esx iproute2 \
                   polkit lxc test remote macvtap libvirtd netcf udev python ebtables \
                   ${@base_contains('DISTRO_FEATURES', 'selinux', 'selinux', '', d)}"

PREFERRED_PROVIDER_virtual/java-initial = "cacao-initial"
PREFERRED_PROVIDER_virtual/java-native = "jamvm-native"
PREFERRED_PROVIDER_virtual/javac-native = "ecj-bootstrap-native"

PREFERRED_VERSION_openjdk-6-jre = "6b27-1.12.5"
PREFERRED_VERSION_icedtea6-native = "1.8.11"

PREFERRED_VERSION_openjdk-7-jre = "25b30-2.3.12"
PREFERRED_VERSION_icedtea7-native = "2.1.3"

PREFERRED_PROVIDER_openjdk-6-jre = "openjdk-6-jre"
PREFERRED_PROVIDER_openjdk-7-jre = "openjdk-7-jre
```

## conf/distro/oel.conf
```bitbake
require conf/distro/poky.conf

DISTRO = "oel"
DISTRO_NAME = "Open Enea Linux"
DISTRO_VERSION = "2014-01-01"
MAINTAINER = "Jon Aldama <jon.aldama@enea.com>"
TARGET_VENDOR = "-oel"
SDK_VENDOR = "-oelsdk"
SDK_VERSION := "${DISTRO_VERSION}"
SDKPATH = "/opt/${DISTRO}/${SDK_VERSION}"

require conf/distro/include/oel-providers.conf
INHERIT += "own-mirrors"
SOURCE_MIRROR_URL ?= "http://autobuilder.yoctoproject.org/sources/"

INHERIT_DISTRO ?= "debian devshell sstate license"

# Lower the priority of meta-oe, as we prefer oe-core when recipes are duped
BBFILE_PRIORITY_openembedded-layer = "1"

# Increase priority of oe-core due to meta-linaro-toolchain strangeness.
BBFILE_PRIORITY_core = "100"

# Quadruple the normal. 'du' is not a good way to really see how much
# space will be needed and fails badly as the fs size grows.
IMAGE_ROOTFS_EXTRA_SPACE = "40960"

# Sane default locales for images
GLIBC_GENERATE_LOCALES ?= "en_US.UTF-8"
IMAGE_LINGUAS ?= "en-us"

# Use a local PR server by default
PRSERV_HOST ?= "localhost:0"

# We want information about image contents
INHERIT += "buildhistory"
BUILDHISTORY_DIR ?= "${TOPDIR}/buildhistory"
BUILDHISTORY_COMMIT ?= "1"
#INHERIT += "toaster"

# Dont be picky with licenses              
COMMERCIAL_LICENSE = ""
LICENSE_FLAGS_WHITELIST += "commercial"

# Archive the source and put them to ${DEPLOY_DIR}/sources/.
#
INHERIT += "archiver"
#
# The tarball for the patched source will be created by default, and you
# can configure the archiver as follow:
#
# Create archive for:
# 1) original (or unpacked) source:
#ARCHIVER_MODE[src] = "original"
# 2) patched source: (default)
ARCHIVER_MODE[src] = "patched"
# 3) configured source:
#ARCHIVER_MODE[src] = "configured"
#
# 4) the patches between do_unpack and do_patch:
#ARCHIVER_MODE[diff] = "1"
# set the files that you'd like to exclude from the diff:
#ARCHIVER_MODE[diff-exclude] ?= ".pc autom4te.cache patches"
#
# 5) the environment data, similar to 'bitbake -e recipe':
#ARCHIVER_MODE[dumpdata] = "1"
#
# 6) the recipe (.bb and .inc):
ARCHIVER_MODE[recipe] = "1"
#
# 7) Whether output the .src.rpm package:
#ARCHIVER_MODE[srpm] = "1"
#
# 8) Filter the license, the recipe whose license in
#    COPYLEFT_LICENSE_INCLUDE will be included, and in
#    COPYLEFT_LICENSE_EXCLUDE will be excluded.
COPYLEFT_LICENSE_INCLUDE = '*'
#COPYLEFT_LICENSE_EXCLUDE = 'CLOSED Proprietary'
#
# 9) Config the recipe type that will be archived, the type can be
#    target, native, nativesdk, cross, crosssdk and cross-canadian,
#    you can set one or more types. Archive all types by default.
COPYLEFT_RECIPE_TYPES = 'target'

# Ensure we have what we need for the below type checks
OE_IMPORTS += "oe.terminal"

# We aren't quite so picky as poky
WARN_QA = "textrel useless-rpaths rpaths staticdev ldflags debug-deps dev-deps"
ERROR_QA = "dev-so debug-files arch la2 pkgconfig la perms"

ROOTFS_POSTPROCESS_COMMAND += "if [ -n '${SDK_VERSION}' ]; then echo '${DISTRO_NAME} ${SDK_VERSION}' > ${IMAGE_ROOTFS}/etc/distro-version; fi;"

# Disable reliance upon upstream URIs, as we want users to be able to
# build without network connectivity
CONNECTIVITY_CHECK_URIS = ""
```

## conf/layer.conf
```bitbake
# We have a conf and classes directory, add to BBPATH
BBPATH .= ":${LAYERDIR}"

# We have a packages directory, add to BBFILES
BBFILES += "${LAYERDIR}/recipes-*/*/*.bb \
            ${LAYERDIR}/recipes-*/*/*.bbappend"

BBFILE_COLLECTIONS += "meta-oel"
BBFILE_PATTERN_meta-oel := "^${LAYERDIR}/"
BBFILE_PRIORITY_meta-oel = "8"
```
